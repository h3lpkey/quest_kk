/*
1 2 4 6 - кеги должны быть true
*/

#include <Wire.h> //библиотека i2c
#define SLAVE_ADDRESS 0x08 // ардуино объявлена слейвом

const int pin_kegs_1        = 12; // Кнопки в кегах
const int pin_kegs_2        = 11;
const int pin_kegs_3        = 10;
const int pin_kegs_4        = 9;
const int pin_kegs_5        = 8;
const int pin_kegs_6        = 7;
    
const int pin_door_office   = 5; // Пин под магнитный замок офиса
    
const int pin_light_office  = 4; // Пин под освещение кабинета

bool right = 0;

void setup() {
        
    Serial.begin(9600);
    
    pinMode(pin_door_office,    OUTPUT);
    pinMode(pin_light_office,   OUTPUT);
    pinMode(pin_kegs_1,         INPUT);
    pinMode(pin_kegs_2,         INPUT);
    pinMode(pin_kegs_3,         INPUT);
    pinMode(pin_kegs_4,         INPUT);
    pinMode(pin_kegs_5,         INPUT);
    pinMode(pin_kegs_6,         INPUT);

    digitalWrite(pin_door_office,  1); 
    digitalWrite(pin_light_office, 1); 
    Wire.begin(SLAVE_ADDRESS);
    Wire.onReceive(receiveData);
    Wire.onRequest(sendData);
    Serial.println("Ready!");
}

void loop() {
    
    if(right == 1) { // Если задачку решили
    
        Serial.println("!!!");
        digitalWrite(pin_door_office,  0); // Открыли дверь
        delay(5000);
        digitalWrite(pin_light_office, 0); // Включили свет
        
    } else { // Если не решили - проверяем
        
        if (digitalRead(pin_kegs_1) == LOW 
        and digitalRead(pin_kegs_2) == LOW 
        and digitalRead(pin_kegs_3) == HIGH 
        and digitalRead(pin_kegs_4) == LOW 
        and digitalRead(pin_kegs_5) == HIGH
        and digitalRead(pin_kegs_6) == LOW) { // 1 2 4 6 кеги
            
            Serial.println("GO!");
            right = 1;
            
        } else { // Неверно
            
            Serial.println("...");
            delay(100);
            
        }  
    }
    
    
} 


void receiveData(int byteCount)
{
  while(Wire.available()) {
    right = Wire.read();
    Serial.print("read: ");
    Serial.println(right);
    delay(100);
  }
}

void sendData()
{
  Wire.write(right);
  Serial.print("send: ");
  Serial.println(right);
  delay(100);
}